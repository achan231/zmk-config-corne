/*
 * Copyright (c) 2020 The ZMK Contributors
 *
 * SPDX-License-Identifier: MIT
 */

#include <behaviors.dtsi>
#include <dt-bindings/zmk/keys.h>
//#include <dt-bindings/zmk/bt.h>
#include <dt-bindings/zmk/rgb.h>
#include <dt-bindings/zmk/ext_power.h>
#include <dt-bindings/zmk/outputs.h>



#define BASE    0
#define LOWER   1
//#define RAISE   2
//#define ADJUST  3


/ {
        keymap {
                compatible = "zmk,keymap";

                default_layer {
// -----------------------------------------------------------------------------------------
// |  TAB |  Q  |  W  |  E  |  R  |  T  |   |  Y  |  U   |  I  |  O  |  P  | GREC |
// | CTRL |  A  |  S  |  D  |  F  |  G  |   |  H  |  J   |  K  |  L  |  ;  |  '   |
// | SHFT |  Z  |  X  |  C  |  V  |  B  |   |  N  |  M   |  ,  |  .  |  /  | ENT  |
//                    | GUI | LALT| SPC |   | BSP | MO1  | MO2 |

                        bindings = <
   &kp TAB      &kp Q   &kp W    &kp E    &kp R     &kp T       &kp Y       &kp U    &kp I        &kp O      &kp P       &gresc
   &kp LCTRL    &kp A   &kp S    &kp D    &kp F     &kp G       &kp H       &kp J    &kp K        &kp L      &kp SEMI    &kp SQT
   &kp LSHFT    &kp Z   &kp X    &kp C    &kp V     &kp B       &kp N       &kp M    &kp COMMA    &kp DOT    &kp FSLH    &kp RET
                                 &kp LGUI &kp LALT  &kp SPACE   &kp BSPC    &mo 1    &mo 2
                        >;
                };

                lower_layer {
                //AKA MO 1 - Alex
// -----------------------------------------------------------------------------------------
// |      |     |     | UP  |     |     |   |  /  |  7  |  8  |  9  |  -  |      |
// | CTRL |     |LEFT |DOWN |RGHT |     |   |  *  |  4  |  5  |  6  |  +  |      |
// | SHFT |     |     |     |     |     |   |  0  |  1  |  2  |  3  | ENT |      |
//                    | GUI |LALT | SPC |   | BSP |?????|  .  |

                        bindings = <
   &kp TAB    &none     &none        &kp UP       &none       &none        &kp FSLH          &kp N7   &kp N8     &kp N9  &kp KP_MINUS  &none
   &kp LCTRL  &none     &kp LEFT     &kp DOWN     &kp RIGHT   &none        &kp KP_ASTERISK   &kp N4   &kp N5     &kp N6  &kp KP_PLUS   &none
   &kp LSHFT  &none     &none        &none        &none       &none        &kp N0            &kp N1   &kp N2     &kp N3  &kp RET       &none
                          	         &kp LGUI     &kp LALT    &kp SPACE    &kp BSPC          &none    &kp KP_DOT
                        >;
/*                };
*
*                raise_layer {
*                //AKA MO 2 - Alex
*// -----------------------------------------------------------------------------------------
*// | CAPS |  !  |  @  |  #  |  $  |  %  |   |  ^  |  &  |  *  |  (  |  )  | DEL  |
*// | CTRL |     |PREV |  PP |NEXT |VOLU |   |  -  |  =  |  [  |  ]  |  \  |  `   |
*// | SHFT |     |BRIDN|BRIUP|MUTE |VOLD |   |  _  |  +  |  {  |  }  | "|" |  ~   |
*//                    | GUI |LART | SPC |   | ENT |     |?????|
*
*                        bindings = <
*   &kp CAPS      &kp EXCL  &kp AT       &kp HASH     &kp DLLR    &kp PRCNT     &kp CARET  &kp AMPS   &kp KP_MULTIPLY &kp LPAR   &kp RPAR   &kp DEL
*   &kp LCTRL     &trans    &kp C_PREV   &kc C_PP     &kp C_NEXT  &kp C_VOL_UP  &kp MINUS  &kp EQUAL  &kp LBKT        &kp RBKT   &kp BSLH   &kp GRAVE
*   &kp LSHFT     &trans    &kp C_BRI_DN &kc C_BRI_UP &kp C_MUTE  &kp C_VOL_DN  &kp UNDER  &kp PLUS   &kp LBRC        &kp RBRC   &kp PIPE   &kp TILDE
*                           &kp LGUI     &kc LALT     &kp SPACE   &kp RET       &trans     &kp RALT
*                        >;
*                };
*/
                
/*
*                adjust_layer {
*                //AKA MO 3 - Alex
*// -----------------------------------------------------------------------------------------
*// |RESET |     |     |     |     |     |   |     | F7  | F8  | F9  |     | F13  |
*// |VCCTOG|MODUP| HUI | SAI |RGBRI|SPEUP|   |     | F4  | F5  | F6  |     | F15  |
*// |RGBTOG|MODDN| HUD | SAD |RGBRD|SPEDN|   |     | F1  | F2  | F3  |     |      |
*//                    | GUI |LALT | SPC |   | BSP |?????|  .  |
*
*                        bindings = <
*   &reset             &none            &none            &none            &none             &none           &none   &kp F7     &kp F8   &kp F9   &none  &kp F13
*   &ext_power EP_TOG  &rgb_ug RGB_EFF  &rgb_ug RGB_HUI  &rgb_ug RGB_SAI  &rgb_ug RGB_BRI   &rgb_ug RGB_SPI &none   &kp F4     &kp F5   &kp F6   &none  &kp F15
*   &rgb_ug RGB_TOG    &rgb_ug RGB_EFR  &rgb_ug RGB_HUD  &rgb_ug RGB_SAD  &rgb_ug RGB_BRD   &rgb_ug RGB_SPD &none   &kp F1     &kp F2   &kp F3   &none  &none
*                                       &kp LGUI         &kp LALT         &kp SPACE         &kp BSPC        &none   &none
*                        >;
*               };
*/
        };
};

